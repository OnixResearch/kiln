## runtime/unikernel/uk.defconfig
```kconfig
CONFIG_UK_NAME="elfloader"
CONFIG_PLAT_KVM=y
CONFIG_KVM_VMM_FIRECRACKER=y
CONFIG_LIBDEVFS=y
CONFIG_LIBPOSIX_ENVIRON=y
CONFIG_LIBPOSIX_EVENT=y
CONFIG_LIBPOSIX_FUTEX=y
CONFIG_LIBPOSIX_PROCESS_MULTITHREADING=y
CONFIG_LIBPOSIX_PROCESS_BRK=y
CONFIG_LIBPOSIX_PROCESS_ARCH_PRCTL=y
CONFIG_LIBPOSIX_PROCESS_SIGNAL=y
CONFIG_LIBUKBOOT_MAINTHREAD=y
CONFIG_LIBUKBOOT_MAXNBARGS=128
CONFIG_LIBUKBOOT_CMDLINE_MAX_LEN=4096
CONFIG_LIBVFSCORE_AUTOMOUNT_CI=y
CONFIG_LIBVFSCORE_AUTOMOUNT_CI_INITRD=y
# CONFIG_LIBLWIP is not set
```
